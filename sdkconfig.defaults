## sdkconfig.defaults
```kconfig
# Enable Power Management
CONFIG_PM_ENABLE=y

# Set flash size
CONFIG_ESPTOOLPY_FLASHSIZE_4MB=y
CONFIG_ESPTOOLPY_FLASHSIZE="4MB"

CONFIG_IDF_TARGET_ESP32C3=y
CONFIG_IDF_TARGET="esp32c3"

# Set max CPU frequency for ESP32C3
CONFIG_ESP32C3_DEFAULT_CPU_FREQ_160=y
CONFIG_ESP32C3_DEFAULT_CPU_FREQ_MHZ=160

# Place SPI in IRAM
CONFIG_SPI_MASTER_IN_IRAM=y
CONFIG_SPI_MASTER_ISR_IN_IRAM=y
CONFIG_SPI_SLAVE_ISR_IN_IRAM=y

# UART ISR in IRAM
CONFIG_UART_ISR_IN_IRAM=y

# GPIO Control Function in IRAM
CONFIG_GPIO_CTRL_FUNC_IN_IRAM=y

# Set -O2 compiler option
CONFIG_COMPILER_OPTIMIZATION_PERF=y

# Enable silent assertions
CONFIG_COMPILER_OPTIMIZATION_ASSERTIONS_SILENT=y
```
